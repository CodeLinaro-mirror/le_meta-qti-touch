## conf/layer.conf
```bitbake
BBFILES += "${LAYERDIR}/recipes/*/*.bb ${LAYERDIR}/recipes/*/*.bbappend ${LAYERDIR}/recipes-*/*/*.bb ${LAYERDIR}/recipes-products/images/*.bbappend"
BBPATH .= ":${LAYERDIR}"
BBFILE_COLLECTIONS += "qti-touch"
BBFILE_PRIORITY_qti-touch = "12"
BBFILE_PATTERN_qti-touch := "^${LAYERDIR}/"
LAYERSERIES_COMPAT_qti-touch = "dunfell kirkstone"
BBMASK += "${@bb.utils.contains_any('BASEMACHINE', ['trustedvm' ,'trustedvm-v2'], 'touchdlkm', 'touch-for-linuxdlkm',  d)}"
# Append Yocto core branch name to OVERRIDES
OVERRIDES:append = ":${LAYERSERIES_COMPAT_core}"
```
